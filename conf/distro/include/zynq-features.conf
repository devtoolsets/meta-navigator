## conf/distro/include/zynq-features.conf
```bitbake
IMAGE_FSTYPES += "tar.gz cpio.gz.u-boot jffs2 ext4"

POKY_DEFAULT_DISTRO_FEATURES = "${BUSYBOX_FEATURES} largefile pam ptest"

# Create packages that support both systemd and sysvinit
# but only on arm/arm64 systems, microblaze is sysvinit only
# DISTRO_FEATURES_BACKFILL_CONSIDERED:remove:arm = "sysvinit systemd"
# DISTRO_FEATURES_BACKFILL:append:arm = " systemd"

# BusyBox features
BUSYBOX_FEATURES = " \
	busybox-hd \
	busybox-mdev \
	busybox-inetd \
	"

# DEFAULT_DISTRO_FEATURES = "fbdev x11"

DISTRO_FEATURES = "${DISTRO_FEATURES_DEFAULT} ${POKY_DEFAULT_DISTRO_FEATURES} ${DEFAULT_DISTRO_FEATURES}"

SKIP_META_VIRT_SANITY_CHECK:zynq = "1"
SKIP_META_SECURITY_SANITY_CHECK:zynq = "1"
SKIP_META_TPM_SANITY_CHECK:zynq = "1"

VIRTUAL-RUNTIME_login_manager = "busybox"

INIT_MANAGER_DEFAULT:zynq = "sysvinit"

INIT_MANAGER ?= "${INIT_MANAGER_DEFAULT}"

INITRAMFS_IMAGE ?= "navigator-image"

# If we enable both systemd and sysvinit DISTRO_FEATURES, we
# need to ensure that the other one is not installed
# PACKAGE_EXCLUDE:append = "${@bb.utils.contains('INIT_MANAGER','systemd',' sysvinit',' systemd',d)}"
# We also need to ensure that dev-pkgs doesn't accidently bring it in either
# PACKAGE_EXCLUDE_COMPLEMENTARY:append = "${@bb.utils.contains('INIT_MANAGER','systemd',' sysvinit',' libsystemd libudev udev systemd',d)}"

# PREFERRED_PROVIDER_iasl-native ?= "iasl-native"
PREFERRED_PROVIDER_virtual/boot-bin ?= "xilinx-bootbin"
PREFERRED_PROVIDER_virtual/dtb ?= "device-tree"

# UBOOT_SUFFIX = "bin"
```

## conf/distro/zynq.conf
```bitbake
require conf/distro/poky.conf
require conf/distro/include/zynq-features.conf
require conf/distro/include/zynq-version.conf

DISTRO = "zynq"
DISTRO_NAME = "zynq"

DISTRO_VERSION := "${@ '-'.join('${XILINX_VER_MAIN} ${XILINX_VER_UPDATE} ${XILINX_VER_BUILD}'.split())}"

SDK_VENDOR = "-zynq"
SDK_VERSION := "${@'${XILINX_VER_MAIN}'.replace('snapshot-${DATE}','snapshot')}"

MAINTAINER = "devtoolset <devtoolset@email.cn>"

TARGET_VENDOR = "-xilinx"

SANITY_TESTED_DISTROS:append = " \
    fedora-38 \n \
	"

# Blacklist packages
SKIP_RECIPE[distro-feed-configs] = "Not supported, see petalinux-image-common.inc for feed config."

# Verify the user's configuration is valid
# INHERIT += "archiver"

# Enable the PR Service
# PRSERV_HOST ?= "localhost:0"

# COPY_LIC_MANIFEST = "1"
# LICENSE_CREATE_PACKAGE = "1"
# BB_GENERATE_MIRROR_TARBALLS = "1"

# Make sure PR service is on
#PRSERV_HOST ??= "localhost:0"

IMAGE_CLASSES += "extrausers"
EXTRA_USERS_PARAMS ?= "\
    useradd -p '$(openssl passwd dev)' dev; \
    usermod -p '$(openssl passwd root)' root; \
    usermod -a -G audio dev; \
    usermod -a -G video dev; \
"
```

## conf/layer.conf
```bitbake
# We have a conf and classes directory, add to BBPATH
BBPATH .= ":${LAYERDIR}"

# We have recipes-* directories, add to BBFILES
BBFILES += "${LAYERDIR}/recipes-*/*/*.bb \
            ${LAYERDIR}/recipes-*/*/*.bbappend"

BBFILE_COLLECTIONS += "meta-navigator"
BBFILE_PATTERN_meta-navigator = "^${LAYERDIR}/"
BBFILE_PRIORITY_meta-navigator = "7"

LAYERDEPENDS_meta-navigator = "core networking-layer xilinx-tools"
LAYERSERIES_COMPAT_meta-navigator = "honister kirkstone langdale"
```

## conf/machine/navigator.conf
```bitbake
#@TYPE: Machine
#@NAME: navigator
#@DESCRIPTION: Machine configuration for the navigator 7020 devices

#### Preamble
MACHINEOVERRIDES =. "${@['', 'navigator:']['navigator' != '${MACHINE}']}"

#### Regular settings follow

# Variables that changes based on hw design or board specific requirement must be
# defined before calling the required inclusion file else pre-expansion value
# defined in local.conf without machine override will not be reflected.

# Yocto Zynq-7000 device-tree variables
YAML_CONSOLE_DEVICE_CONFIG:pn-device-tree ?= "ps7_uart_0"
YAML_MAIN_MEMORY_CONFIG:pn-device-tree ?= "PS7_DDR_0"
DT_PADDING_SIZE:pn-device-tree ?= "0x1000"
DTC_FLAGS:pn-device-tree = "-@"
EXTRA_DT_FILES += ""
# YAML_DT_BOARD_FLAGS ?= "{BOARD zc702}"
YAML_DT_BOARD_FLAGS ?= "{BOARD template}"

# Yocto Zynq-7000 u-boot-xlnx variables
UBOOT_MACHINE ?= "xilinx_zynq_virt_defconfig"
BOOTMODE ?= "generic.root"

# Yocto Zynq-7000 FSBL variables
YAML_SERIAL_CONSOLE_STDIN:pn-fsbl-firmware ?= "ps7_uart_0"
YAML_SERIAL_CONSOLE_STDOUT:pn-fsbl-firmware ?= "ps7_uart_0"
YAML_COMPILER_FLAGS:pn-fsbl-firmware = " "

# Yocto KERNEL Variables
UBOOT_ENTRYPOINT  ?= "0x200000"
UBOOT_LOADADDRESS ?= "0x200000"
KERNEL_IMAGETYPE  ?= "zImage"
KERNEL_ALT_IMAGETYPE ?= "uImage"
KERNEL_EXTRA_ARGS += "UIMAGE_LOADADDR=${UBOOT_ENTRYPOINT}"

#Add FIT Variables
KERNEL_CLASSES    += " kernel-fitimage"
KERNEL_IMAGETYPES += " fitImage vmlinux"

# Zynq-7000 Serial Console settings
SERIAL_CONSOLES ?= "115200;ttyPS0"
SERIAL_CONSOLES_CHECK = "${SERIAL_CONSOLES}"
YAML_SERIAL_CONSOLE_BAUDRATE ?= "115200"

#Add u-boot-xlnx-scr Variables
DDR_BASEADDR = "0x0"
BOOTFILE_EXT = ""
RAMDISK_IMAGE = "rootfs.cpio.gz.u-boot"
RAMDISK_IMAGE1 = "ramdisk.cpio.gz.u-boot"
SKIP_APPEND_BASEADDR = "0"
KERNEL_IMAGE = "uImage"
DEVICETREE_OFFSET = "0x100000"
KERNEL_OFFSET = "0x200000"
RAMDISK_OFFSET = "0x4000000"
QSPI_KERNEL_OFFSET = "0xA00000"
QSPI_KERNEL_SIZE = "0x600000"
QSPI_RAMDISK_OFFSET = "0x1000000"
QSPI_RAMDISK_SIZE = "0xF80000"
QSPI_FIT_IMAGE_OFFSET = "0xA80000"
QSPI_FIT_IMAGE_SIZE = "0x1500000"
NAND_KERNEL_OFFSET = "0x1000000"
NAND_KERNEL_SIZE = "0x3200000"
NAND_RAMDISK_OFFSET = "0x4600000"
NAND_RAMDISK_SIZE = "0x3200000"
NAND_FIT_IMAGE_OFFSET = "0x1080000"
NAND_FIT_IMAGE_SIZE = "0x6400000"
FIT_IMAGE = "image.ub"
FIT_IMAGE_OFFSET = "0x10000000"
PRE_BOOTENV = ""

SPL_BINARY = ""
HAS_PLATFORM_INIT += " xilinx_zynq_virt_defconfig"

require conf/machine/include/soc-zynq.inc
require conf/machine/include/machine-xilinx-default.inc
require conf/machine/include/machine-xilinx-qemu.inc

# zynq-generic.conf uses zc702-zynq7 xsa as reference input.
# User can override with custom xsa using HDF_BASE and HDF_PATH variables from
# local.conf.
HDF_MACHINE = "zc702-zynq7"

MACHINE_FEATURES += "rtc ext2 ext3 vfat usbhost usbgadget"

MACHINE_ESSENTIAL_EXTRA_RDEPENDS += "device-tree"

EXTRA_IMAGEDEPENDS += " \
    libyaml-native \
    python3-cython-native \
    python3-pyyaml-native \
    virtual/fsbl \
    virtual/bootloader \
    u-boot-xlnx-scr \
    xilinx-bootbin \
    "
EXTRA_IMAGEDEPENDS:remove = "virtual/boot-bin "

IMAGE_BOOT_FILES += " \
    boot.bin \
    ${@bb.utils.contains('PREFERRED_PROVIDER_virtual/dtb', 'device-tree', 'system.dtb', '', d)} \
    boot.scr \
    uImage \
    "

IMAGE_CLASSES += "image-types-xilinx-qemu"
# Add wic.qemu-sd only if initramfs_image not set due to circular dependecies
IMAGE_FSTYPES += "${@'wic.qemu-sd' if (d.getVar('INITRAMFS_IMAGE') or '') == '' else 'cpio.gz'}"

# Zynq-7000 QEMU Configurations
# This machine has a QEMU model, runqemu setup:
QB_MEM = "-m 1024"
QB_NETWORK_DEVICE = "-net nic,netdev=net0,macaddr=@MAC@"

QB_KERNEL_ROOT = "/dev/mmcblk0p2"

# Replicate BootROM like behaviour, having loaded SPL and PMU(ROM+FW)
QB_OPT_APPEND = " \
	-serial mon:stdio \
	-gdb tcp::9000 \
	-device loader,addr=0xf8000008,data=0xDF0D,data-len=4 \
	-device loader,addr=0xf8000140,data=0x00500801,data-len=4 \
	-device loader,addr=0xf800012c,data=0x1ed044d,data-len=4 \
	-device loader,addr=0xf8000108,data=0x0001e008,data-len=4 \
	-device loader,addr=0xF8000910,data=0xF,data-len=0x4 \
	-machine linux=on \
	"

#SDK variables
SDK_EXT_TYPE = "minimal"
SDK_INCLUDE_BUILDTOOLS = "0"
```

## meta-zynq/conf/distro/zynq.conf
```bitbake
require conf/distro/poky.conf
require conf/distro/include/zynq-features.conf
require conf/distro/include/zynq-version.conf

DISTRO = "zynq"
DISTRO_NAME = "zynq"

DISTRO_VERSION := "${@ '-'.join("${XILINX_VER_MAIN} ${XILINX_VER_UPDATE} ${XILINX_VER_BUILD}".split())}"

SDK_VENDOR = "-zynq"
SDK_VERSION := "${@'${XILINX_VER_MAIN}'.replace('snapshot-${DATE}','snapshot')}"

MAINTAINER = "devtoolset <devtoolset@email.cn>"

TARGET_VENDOR = "-xilinx"

#SANITY_TESTED_DISTROS:append = " \
#    fedora-38 \n \
#	"

# Blacklist packages
INHERIT += "blacklist"
PNBLACKLIST[distro-feed-configs] = "Not supported, see petalinux-image-common.inc for feed config."
PNBLACKLIST[qemu-native] = "Only qemu-xilinx-native is support."
PNBLACKLIST[nativesdk-qemu] = "Only nativesdk-qemu is supported."
PNBLACKLIST[qemu-helper-native] = "Only qemu-xilinx-helper-native is supported."

# INHERIT += "buildhistory"
# BUILDHISTORY_COMMIT = "1"

# Verify the user's configuration is valid
# INHERIT += "externalsrc"
# INHERIT += "archiver"

# Enable the PR Service
# PRSERV_HOST ?= "localhost:0"

# COPY_LIC_MANIFEST = "1"
# LICENSE_CREATE_PACKAGE = "1"
# BB_GENERATE_MIRROR_TARBALLS = "1"

# Make sure PR service is on
#PRSERV_HOST ??= "localhost:0"

# Configure default users/groups
# Default rules (assumed no debug-tweaks image feature):
# * disabled root login (set by system default)
# * Add a user 'petalinux' with no password
#   - SSH won't allow passwd-less login w/o debug tweaks, so requires console login
#   - Set to immediately expire
#   - Add to the sudoers file
# * Add 'petalinux' user to the audio group
# * Add 'petalinux' user to the video group
IMAGE_CLASSES += "extrausers"
EXTRA_USERS_PARAMS ?= "\
    useradd -p dev dev;passwd-expire dev; \
    usermod -a -G audio dev; \
    usermod -a -G video dev; \
    groupadd -r aie; \
    usermod -a -G aie dev; \
"
```

## meta-zynq/conf/layer.conf
```bitbake
# We have a conf and classes directory, add to BBPATH
BBPATH =. "${LAYERDIR}:"

# We have recipes-* directories, add to BBFILES
BBFILES += "${LAYERDIR}/recipes-*/*/*.bb \
            ${LAYERDIR}/recipes-*/*/*.bbappend"

BBFILE_COLLECTIONS += "meta-zynq"
BBFILE_PATTERN_meta-zynq = "^${LAYERDIR}/"
BBFILE_PRIORITY_meta-zynq = "7"

LAYERDEPENDS_meta-zynq  = "core"
LAYERDEPENDS_meta-zynq += "networking-layer"

LAYERSERIES_COMPAT_meta-zynq = "honister"
```
